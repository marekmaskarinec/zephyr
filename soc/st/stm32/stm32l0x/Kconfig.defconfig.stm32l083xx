## soc/st/stm32/stm32l0x/Kconfig.defconfig.stm32l083xx
```kconfig
# ST Microelectronics STM32L083XX MCU

# Copyright (c) 2024 Marek Maškarinec <marek.maskarinec@hardwario.com>
# SPDX-License-Identifier: Apache-2.0

if SOC_STM32L083XX

config NUM_IRQS
	default 32

endif # SOC_STM32L083XX
```
